## firmware/tests/integration/testcase.yaml
```yaml
tests:
  cicala.integration:
    platform_allow:
      - qemu_xtensa/dc233c
      - native_sim
    integration_platforms:
      - qemu_xtensa/dc233c
    tags:
      - cicala
      - integration
  cicala.integration.rev_a_power:
    platform_allow:
      - qemu_xtensa/dc233c
      - native_sim
    integration_platforms:
      - qemu_xtensa/dc233c
    extra_args:
      - EXTRA_DTC_OVERLAY_FILE=charger.overlay
    extra_configs:
      - CONFIG_CICALA_POWER_DIVIDER_NUM=147
      - CONFIG_CICALA_POWER_DIVIDER_DEN=47
    tags:
      - cicala
      - integration
```

## firmware/tests/layout/testcase.yaml
```yaml
tests:
  cicala.layout:
    platform_allow:
      - qemu_xtensa/dc233c
      - native_sim
    integration_platforms:
      - qemu_xtensa/dc233c
    tags:
      - cicala
      - layout
```

## firmware/tests/qdb/testcase.yaml
```yaml
tests:
  tischkarte.qdb:
    platform_allow:
      - qemu_xtensa/dc233c
      - native_sim
    integration_platforms:
      - qemu_xtensa/dc233c
    tags:
      - tischkarte
      - qdb
```

## firmware/tests/retained/testcase.yaml
```yaml
tests:
  tischkarte.retained:
    platform_allow:
      - qemu_xtensa/dc233c
      - native_sim
    integration_platforms:
      - qemu_xtensa/dc233c
    tags:
      - tischkarte
      - retained
```
