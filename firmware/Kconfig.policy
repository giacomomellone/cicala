## firmware/Kconfig.policy
```kconfig
# Product policy shared by the application and firmware tests.
# Measured settings cite their basis in the help text.

config CICALA_BUTTON_DEBOUNCE_MS
    int "Category and Next debounce (ms)"
    default 30
    help
      Debounce used by gpio-keys. Keep it equal to debounce-interval-ms in
      every board overlay. One event is emitted when a button is released.

config CICALA_CORPUS_LANGUAGE
    string "Language of the corpus compiled into the image"
    default "en"
    help
      Factory corpus used before network setup. It must match a bundle built
      by `just bundle`.

config CICALA_PANEL_MARGIN_PX
    int "Blank border around the text (pixels)"
    default 10
    help
      Ten pixels equals one cfb_font_1016 character cell.

config CICALA_PANEL_FLOOR_PCT
    int "Height of the floor dither, as a percentage of the panel"
    default 12
    range 0 40
    help
      Ordered dither rising from the bottom edge, matching the website. Twelve
      percent is 15 of 122 rows. The text block is centred and the leading cap
      pushes it outward, so across the shipped corpus the median clear space
      below the last line is 17 rows and the worst case is 10: 86 of 232
      questions have the top of the ramp inside their descenders, where it is
      down to about a quarter of full strength. Set 0 to draw no floor.

config CICALA_PANEL_COLUMNS
    int "Characters per line the panel fits"
    default 23
    help
      (250 - 2 * margin) / 10 for cfb_font_1016. A build assertion checks the
      configured value against the panel width.

config CICALA_PANEL_LINES
    int "Lines of text the panel fits"
    default 6
    help
      (122 - 2 * margin) / 16 for cfb_font_1016. The corpus layout test checks
      every shipped question.

config CICALA_PANEL_AUTOSIZE
    bool "Pick the largest font each question fits in"
    default y
    help
      Choose among the 10x16, 15x24, and 20x32 CFB fonts. Disabled mode always
      uses 10x16.

config CICALA_PANEL_MAX_LEADING_PCT
    int "Most extra space between lines, as a percentage of the font height"
    default 50
    range 0 100
    help
      Cap the unused vertical space shared between lines. The default raises
      average vertical fill from 66% to 82% on the shipped corpus.

config CICALA_PANEL_BOLD
    bool "Thicken glyphs by overdrawing"
    default y
    help
      Draw each glyph again one pixel to the right. Disable for hardware font
      comparisons.

config CICALA_DEBUG_CHARSET
    bool "Show character-set test pages instead of questions"
    default n
    help
      Next advances through ASCII, language samples, and composed diacritics.
      Used by the charset profile.

config CICALA_DEBUG_SOAK
    bool "Press Next automatically, forever"
    default n
    help
      Schedule Next after each refresh. The soak profile suppresses periodic
      full refreshes so panel ghosting accumulates.

config CICALA_DEBUG_SOAK_INTERVAL_MS
    int "Wait between a finished refresh and the next automatic press (ms)"
    default 5000
    depends on CICALA_DEBUG_SOAK
    help
      Delay from a completed refresh to the next automatic press.

config CICALA_DEBUG_SOAK_REBOOT
    bool "Reboot part-way through a soak run"
    default n
    depends on CICALA_DEBUG_SOAK
    select REBOOT
    help
      Warm-reboot during a soak run to test RTC-retained shuffle, refresh, and
      panel state. A cold reset clears the RTC domain.

config CICALA_DEBUG_SOAK_REBOOT_EVERY
    int "Presses between reboots"
    default 3
    depends on CICALA_DEBUG_SOAK_REBOOT

config CICALA_SLEEP
    bool "Enter deep sleep when the table goes quiet"
    default n
    depends on !CICALA_DEBUG_SOAK && !CICALA_DEBUG_CHARSET
    select POWEROFF
    select PM
    help
      Enter ESP32-S3 deep sleep after the idle window. RTC memory preserves
      tabletop state across the restart. The release board enables this.

config CICALA_PANEL_DEEP_SLEEP
    bool "Put the panel controller to sleep too"
    default n
    depends on CICALA_SLEEP
    select SSD16XX_PRESERVE_IMAGE_HW_RESET
    help
      Put the SSD1680 into RAM-retaining deep sleep. Current saving and RAM
      retention across the wake reset remain unmeasured.

config CICALA_SLEEP_IDLE_MS
    int "Quiet time before sleeping (ms)"
    default 2000
    depends on CICALA_SLEEP
    help
      Measured from the latest input, category change, or refresh.

config CICALA_REFRESH_TIMEOUT_MS
    int "How long to wait for the display before giving up (ms)"
    default 15000
    help
      Bounds a stalled refresh. Bench measurements are 622 ms for a partial
      refresh and about 2315 ms for a full refresh at room temperature.

config CICALA_FULL_REFRESH_INTERVAL
    int "Partial refreshes between full refreshes"
    default 16
    help
      Sixteen partial refreshes remain clean in normal use. A soak run reached
      193 before artifacts became unacceptable.

config CICALA_PLAYBACK_DEPTH_MAX
    int "Maximum editorial depth in normal playback"
    default 2
    range 1 3
    help
      Normal playback excludes depth 3. See docs/design.md.

config CICALA_RECENT_RING
    int "Questions excluded from the start of a new bag cycle"
    default 20
    help
      Shared across categories. When the ring excludes every remaining
      question in a category, the bag relaxes the ring.

config CICALA_TEXTURE
    bool "Prefer a different depth band and form than the last question"
    default y
    help
      The bag scores each candidate against the question just served — same
      depth band, same form — and draws uniformly from the cheapest class,
      relaxing toward uniform when the pool offers nothing cheaper. Texture
      decorrelates consecutive draws; it is not session state and does not
      escalate. Disable for A/B studies. See docs/design.md.

config CICALA_MAX_QUESTIONS
    int "Largest corpus the bag can track"
    default 512
    help
      Sets the RTC bitmap width: one bit per question per category. A 512-item
      limit uses 384 bytes. Larger bundles are rejected by Qdb::open().

config CICALA_DEBUG_CORPUS_STORE
    bool "Write the compiled-in corpus to the filesystem at boot"
    default n
    depends on FILE_SYSTEM_LITTLEFS
    help
      Exercise the LittleFS read path used by synced corpora. Used by the
      corpus profile.

config CICALA_MAX_CORPUS_BYTES
    int "Largest synced corpus the device will read (bytes)"
    default 32768
    help
      QDB keeps pointers into one RAM buffer. This limit covers 512 questions;
      the 240-question English corpus is about 15 KB.

config CICALA_MAX_QUESTION_BYTES
    int "Largest question the device will render (UTF-8 bytes)"
    default 128
    help
      Bounds messages on chan_question. The longest shipped question is 94
      bytes, and the QDB suite checks every built bundle.

config CICALA_NET
    bool "Wi-Fi, and the setup portal that configures it"
    default n
    help
      Enable Wi-Fi, stored credentials, the setup access point, and HTTP
      services. The release board enables this.

config CICALA_DEBUG_PORTAL
    bool "Enter setup at every boot, without the gesture"
    default n
    depends on CICALA_NET
    help
      Used by the portal profile.

config CICALA_SYNC
    bool "Fetch question bundles over the network"
    default n
    depends on CICALA_NET
    help
      Download, verify, and install newer question bundles. Enable this only
      with a reachable CICALA_SYNC_BASE_URL. See docs/sync_protocol.md.

config CICALA_SYNC_BASE_URL
    string "Where the manifest and bundles are served from"
    default "http://device.cicala.dev/device"
    depends on CICALA_SYNC
    help
      Base URL for manifest.json and bundle URLs. Redirects are unsupported;
      the default is the production artifact host, which answers on port 80.

config CICALA_SYNC_HOST
    string "Host name to connect to and resolve"
    default "device.cicala.dev"
    depends on CICALA_SYNC
    help
      The production artifact host, an S3 static-website endpoint behind a
      DNS-only CNAME. Bench builds override this explicitly.

config CICALA_SYNC_PORT
    int "Port"
    default 80
    depends on CICALA_SYNC

config CICALA_SYNC_INSECURE
    bool "Connect without TLS"
    default y
    depends on CICALA_SYNC
    help
      Use plain HTTP. Ed25519 authenticates artifacts; traffic remains visible.

config CICALA_OTA
    bool "Install firmware updates over the network"
    default n
    depends on CICALA_SYNC
    depends on BOOTLOADER_MCUBOOT
    select STREAM_FLASH
    select IMG_MANAGER
    select IMG_ERASE_PROGRESSIVELY
    select REBOOT
    help
      Download a newer image into the spare MCUboot slot, verify it, and mark
      it for installation. See docs/firmware_update.md.

      CICALA_SYNC supplies the shared connection and signature code.
      BOOTLOADER_MCUBOOT supplies the spare slot and installer. STREAM_FLASH is
      selected explicitly because IMG_MANAGER depends on it without selecting
      it. Progressive erase avoids one large erase before the download.

config CICALA_OTA_BASE_URL
    string "Where the firmware manifest and images are served from"
    default "http://device.cicala.dev/device"
    depends on CICALA_OTA
    help
      Base URL for firmware.json and image URLs. It may differ from the bundle
      URL, but both endpoints must resolve through CICALA_SYNC_HOST.

config CICALA_OTA_ON_COLD_BOOT
    bool "Check for firmware on a cold boot, after the corpus sync"
    default y
    depends on CICALA_OTA
    help
      Disable this to allow updates only from the portal sync action.

config CICALA_PORTAL_SSID_PREFIX
    string "Setup network name, before the per-device suffix"
    default "Cicala"
    depends on CICALA_NET
    help
      The SoftAP name is <prefix>-XXXX, using a suffix derived from the device
      id.

config CICALA_PORTAL_ENTRY_HOLD_MS
    int "Both buttons held this long after boot to enter setup (ms)"
    default 2000
    depends on CICALA_NET

config CICALA_PORTAL_WINDOW_MS
    int "How long the portal stays up (ms)"
    default 300000
    help
      Measured from HTTP startup. A successful network join restarts the window
      once for the status page.

config CICALA_PORTAL_SCAN_MS
    int "How long to wait for the scan before giving up on it (ms)"
    default 8000
    help
      Scan before starting the access point because both share one radio. The
      setup form accepts a typed SSID when scanning times out.

config CICALA_NET_CONNECT_TIMEOUT_MS
    int "How long to wait for a network to accept us (ms)"
    default 20000
    help
      Covers association, authentication, and DHCP. A timeout returns the
      portal to its setup page.

config CICALA_NET_SCAN_MAX
    int "Networks kept from a scan"
    default 12
    depends on CICALA_NET
    help
      Bounds the setup-page scan list. Each retained entry uses 34 bytes.

config CICALA_POWER
    bool "Measure the cell, and decide what its voltage means"
    default n
    select ADC
    help
      Sample battery voltage and VBUS. Power state gates panel refreshes,
      controls wakefulness, and drives status LEDs. See docs/hardware_wiring.md.

config CICALA_REFRESH_MIN_MV
    int "Minimum cell voltage for a panel refresh (mV)"
    default 3200
    help
      Below this value the panel remains unchanged and power state becomes LOW.
      The panel failure threshold remains an open measurement.

config CICALA_POWER_CRITICAL_MV
    int "Cell voltage below which the device says so loudly (mV)"
    default 3000
    depends on CICALA_POWER
    help
      LOW gives one amber blink; CRITICAL gives three red blinks. Both refuse
      panel refreshes.

config CICALA_POWER_PLAUSIBLE_MV
    int "Lowest pack reading that could be a cell (mV)"
    default 2500
    depends on CICALA_POWER
    help
      Lower values indicate a missing or faulty divider and produce UNKNOWN,
      which leaves refreshes enabled.

config CICALA_POWER_FULL_MV
    int "Breadboard voltage estimate for the green LED (mV)"
    default 4050
    depends on CICALA_POWER
    help
      Applies when charger status pins are absent. The breadboard divider
      reads about 40 mV low. Rev A uses charger status and never infers charge
      completion from this threshold.

config CICALA_POWER_HYSTERESIS_MV
    int "Millivolts a reading must clear a threshold by to cross back (mV)"
    default 120
    depends on CICALA_POWER
    help
      Applied during voltage recovery. Panel refreshes can sag the pack by more
      than 120 mV for about two seconds.

config CICALA_POWER_SAMPLE_MS
    int "Time between readings while awake (ms)"
    default 10000
    depends on CICALA_POWER
    help
      Periodic interval for long awake periods such as charging and setup.

config CICALA_POWER_CONFIRM_SAMPLES
    int "Readings averaged into the one taken at boot"
    default 4
    range 1 16
    depends on CICALA_POWER

config CICALA_POWER_CHARGE_WINDOW_MS
    int "How long a plug-in keeps the sync and update window open (ms)"
    default 300000
    depends on CICALA_POWER
    help
      Limits network work for one continuous external-power connection. The
      device remains awake while VBUS is present.

config CICALA_REV_A
    bool "Cicala Rev A PCB"
    default n
    help
      Enables the switched panel supply and the rotated display's cold-RAM
      refresh policy. Build with rev_a.overlay and rev_a.conf together.

config CICALA_POWER_DIVIDER_SETTLE_MS
    int "Switched battery divider settling time (ms)"
    default 0
    range 0 1000
    depends on CICALA_POWER
    help
      Rev A uses 1 MOhm / 470 kOhm and 100 nF. Allow 200 ms after enabling
      its switch, including resistor and capacitor tolerance.

config CICALA_POWER_DIVIDER_NUM
    int "Battery divider, numerator"
    default 2
    depends on CICALA_POWER
    help
      Pack millivolts equal the ADC reading times NUM / DEN. The 470 kΩ /
      470 kΩ bench divider uses 2 / 1.

config CICALA_POWER_DIVIDER_DEN
    int "Battery divider, denominator"
    default 1
    depends on CICALA_POWER

config CICALA_POWER_WAKE_ON_USB
    bool "Wake from deep sleep when USB is plugged in"
    default n
    depends on CICALA_POWER
    help
      VBUS uses EXT0 because the active-low buttons use EXT1. EXT0 keeps the RTC
      peripheral domain powered, so enable this only after measuring its sleep
      current.

config CICALA_DEBUG_POWER
    bool "Log the cell voltage continuously"
    default n
    depends on CICALA_POWER
    help
      Sample once per second and log raw and converted values. Used by the
      power profile for calibration and discharge measurements.

config CICALA_STATUS_LED
    bool "Show power, the portal and transfers on two LEDs"
    default n
    depends on CICALA_POWER
    help
      Drive active-high red and green GPIO LEDs. Boards without a cicala_leds
      devicetree node compile this feature out.

config CICALA_STATUS_LED_BLINK_MS
    int "On, and off, time of one blink (ms)"
    default 200
    depends on CICALA_STATUS_LED

config CICALA_STATUS_LED_PULSE_MS
    int "Full cycle of the transfer pulse (ms)"
    default 1500
    depends on CICALA_STATUS_LED
```

## firmware/tests/app_fsm/testcase.yaml
```yaml
tests:
  cicala.app_fsm:
    platform_allow:
      - qemu_xtensa/dc233c
      - native_sim
    integration_platforms:
      - qemu_xtensa/dc233c
    tags:
      - cicala
      - app_fsm
```

## firmware/tests/ed25519/testcase.yaml
```yaml
tests:
  cicala.ed25519:
    platform_allow:
      - qemu_xtensa/dc233c
      - native_sim
    integration_platforms:
      - qemu_xtensa/dc233c
    timeout: 300
    tags:
      - cicala
      - ed25519
```

## firmware/tests/input/testcase.yaml
```yaml
tests:
  kveld.input:
    platform_allow:
      - qemu_xtensa/dc233c
      - native_sim
    integration_platforms:
      - qemu_xtensa/dc233c
    tags:
      - kveld
      - input
```
