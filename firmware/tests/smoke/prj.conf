## CMakeLists.txt
```
cmake_minimum_required(VERSION 3.20.0)

find_package(Zephyr REQUIRED HINTS $ENV{ZEPHYR_BASE})
project(cicala_smoke LANGUAGES C CXX)

target_sources(app PRIVATE src/main.cpp)
```

## prj.conf
```kconfig
CONFIG_ZTEST=y

CONFIG_CPP=y
CONFIG_STD_CPP17=y
CONFIG_CPP_EXCEPTIONS=n
CONFIG_CPP_RTTI=n

CONFIG_LOG=y
CONFIG_LOG_MODE_IMMEDIATE=y
```

## src/main.cpp
```c
#include <zephyr/ztest.h>

ZTEST_SUITE(cicala_smoke, NULL, NULL, NULL, NULL, NULL);

ZTEST(cicala_smoke, test_harness_runs)
{
    zassert_true(true, "ztest runs on native_sim");
}

ZTEST(cicala_smoke, test_cpp17_available)
{
    constexpr struct {
        int deck;
        int depth;
    } q{5, 2};
    const auto [deck, depth] = q;

    zassert_equal(deck, 5);
    zassert_equal(depth, 2);
}
```
